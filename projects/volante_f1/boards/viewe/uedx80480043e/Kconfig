## projects/volante_f1/boards/viewe/uedx80480043e/Kconfig
```kconfig
# Copyright (c) 2025 Stefan Golinschi <stefan.golinschi@gmail.com>
# SPDX-License-Identifier: Apache-2.0

config HEAP_MEM_POOL_ADD_SIZE_BOARD
	int
	default 4096 if BOARD_UEDX80480043E_ESP32S3_PROCPU
	default 256 if BOARD_UEDX80480043E_ESP32S3_APPCPU
```

## projects/volante_f1/boards/viewe/uedx80480043e/Kconfig.uedx80480043e
```kconfig
config BOARD_UEDX80480043E
    select SOC_ESP32S3_WROOM_N16R8
    select SOC_ESP32S3_PROCPU if BOARD_UEDX80480043E_ESP32S3_PROCPU
```

## projects/volante_f1/boards/viewe/uedx80480043e/uedx80480043e_esp32s3_procpu_defconfig
```kconfig
CONFIG_HEAP_MEM_POOL_SIZE=4096

CONFIG_LED_STRIP=y

CONFIG_CONSOLE=y
CONFIG_SERIAL=y
CONFIG_UART_CONSOLE=y
CONFIG_GPIO=y
CONFIG_CLOCK_CONTROL=y
```
